## CMakeLists.txt
```
cmake_minimum_required(VERSION 3.20.0)
find_package(Zephyr REQUIRED HINTS $ENV{ZEPHYR_BASE})

project(scan-adv-2)

target_sources(app PRIVATE
    src/main.c
    src/buffer_manager.c
    src/uart_handler.c
    src/chunk_protocol.c
)
```

## prj.conf
```kconfig
# UART configuration
CONFIG_SERIAL=y
CONFIG_UART_CONSOLE=y
CONFIG_CONSOLE=y
CONFIG_UART_ASYNC_API=n
CONFIG_UART_INTERRUPT_DRIVEN=n
CONFIG_UART_LINE_CTRL=n

# Logging configuration
CONFIG_LOG=y
CONFIG_LOG_DEFAULT_LEVEL=4
CONFIG_LOG_MODE_IMMEDIATE=y
CONFIG_LOG_BACKEND_UART=y
CONFIG_LOG_BACKEND_RTT=n
CONFIG_LOG_PRINTK=y

# Basic system settings
CONFIG_MAIN_STACK_SIZE=2048
CONFIG_SYSTEM_WORKQUEUE_STACK_SIZE=2048
CONFIG_NEWLIB_LIBC=y
```

## boards/nrf21540dk_nrf52840.overlay
```dts
/ {
    chosen {
        zephyr,console = &uart0;
        zephyr,shell-uart = &uart0;
    };
};

&uart0 {
    status = "okay";
    current-speed = <115200>;
};
```

## boards/nrf52833dk_nrf52833.overlay
```dts
/ {
    chosen {
        zephyr,console = &uart0;
        zephyr,shell-uart = &uart0;
    };
};

&uart0 {
    status = "okay";
    current-speed = <115200>;
    pinctrl-0 = <&uart0_default>;
    pinctrl-1 = <&uart0_sleep>;
    pinctrl-names = "default", "sleep";
};
```

## src/main.c
```c
#include "uart_handler.h"
#include <zephyr/kernel.h>
#include <zephyr/logging/log.h>

LOG_MODULE_REGISTER(main, LOG_LEVEL_INF);

/* Test message to send */
static const uint8_t test_msg[] = "UART Test Message\r\n";

/* Work item for periodic sending */
static struct k_work_delayable send_work;

/* Send work handler */
static void send_work_handler(struct k_work *work) {
    // Send test message
    int err = uart_write_bytes(test_msg, sizeof(test_msg) - 1);
    if (err) {
        LOG_ERR("Failed to send test message: %d", err);
    } else {
        LOG_INF("Sent test message");
    }

    // Try to read any response (non-blocking)
    uint8_t byte;
    while (uart_read_byte(&byte, K_NO_WAIT) == 0) {
        LOG_INF("Received byte: 0x%02X", byte);
    }

    // Schedule next send
    k_work_reschedule(&send_work, K_MSEC(1000));
}

/* Main function */
int main(void) {
    int err;

    LOG_INF("Starting UART Test...");

    // Initialize UART
    err = uart_init();
    if (err) {
        LOG_ERR("UART init failed: %d", err);
        return err;
    }

    LOG_INF("UART initialized successfully");

    // Initialize work item
    k_work_init_delayable(&send_work, send_work_handler);

    // Schedule first send
    k_work_reschedule(&send_work, K_MSEC(1000));

    // Main loop
    while (1) {
        k_sleep(K_SECONDS(1));
    }

    return 0;
}
```

## src/ble_scanner.h
```c
#ifndef BLE_SCANNER_H
#define BLE_SCANNER_H

#include <zephyr/kernel.h>
#include <zephyr/bluetooth/bluetooth.h>
#include <zephyr/bluetooth/hci.h>
#include <zephyr/logging/log.h>
#include <zephyr/drivers/uart.h>

/* Configuration Constants */
#define MAX_DEVICES              50    /* Maximum number of devices to track */
#define SAMPLING_INTERVAL_MS     5000  /* Buffer switch interval */
#define UART_BAUD_RATE          115200
#define UART_HEADER_MAGIC       0x55   /* Synchronization pattern: 01010101 */

/* BLE Advertisement Data Structure */
struct __packed device_data {
    uint8_t addr[6];          /* MAC address */
    uint8_t addr_type;        /* Address type (public/random) */
    uint8_t adv_type;         /* Advertisement type */
    int8_t  rssi;            /* RSSI value */
    uint8_t data_len;        /* Length of advertisement data */
    uint8_t data[31];        /* Raw advertisement data */
    uint8_t n_adv;           /* Number of advertisements seen */
    int32_t last_seen;       /* Timestamp of last advertisement */
};

/* Buffer Header Structure */
struct __packed buffer_header {
    uint8_t magic[4];         /* [0x55, 0x55, 0x55, 0x55] */
    uint8_t sequence;         /* Message sequence number */
    uint16_t n_adv_raw;       /* Total advertisements seen */
    uint8_t n_mac;           /* Number of unique MACs */
    int32_t timestamp;       /* Buffer creation timestamp */
};

/* Function Declarations */
int ble_scanner_init(void);
void ble_scanner_start(void);
void ble_scanner_stop(void);

/* Error Codes */
#define ERR_BLE_INIT_FAILED    -1
#define ERR_UART_INIT_FAILED   -2
#define ERR_BUFFER_INIT_FAILED -3

#endif /* BLE_SCANNER_H */
```

## src/buffer_manager.c
```c
#include "buffer_manager.h"

LOG_MODULE_DECLARE(ble_scanner);

static struct buffer_manager buffer_mgr;

/* Get buffer manager instance */
struct buffer_manager *get_buffer_manager(void) {
    return &buffer_mgr;
}

/* Calculate hash from MAC address */
static uint32_t hash_mac(const uint8_t *mac) {
    uint32_t hash = 0;
    for (int i = 0; i < 6; i++) {
        hash = (hash << 5) + hash + mac[i];  // hash * 33 + mac[i]
    }
    return hash & HASH_MASK;
}

/* Initialize the buffer manager */
int buffer_manager_init(void) {
    // Initialize buffer switching semaphore
    k_sem_init(&buffer_mgr.switch_lock, 1, 1);
    buffer_mgr.msg_sequence = 0;
    
    // Initialize both buffers
    for (int i = 0; i < 2; i++) {
        struct ble_buffer *buf = &buffer_mgr.buffers[i];
        
        // Initialize buffer semaphore
        k_sem_init(&buf->lock, 1, 1);
        
        // Clear buffer contents
        memset(&buf->header, 0, sizeof(struct buffer_header));
        memset(buf->hash_table, 0, sizeof(buf->hash_table));
        
        // Set initial state
        buf->state = BUFFER_EMPTY;
        buf->hash_entries = 0;
        
        // Initialize header magic pattern
        memset(buf->header.magic, UART_HEADER_MAGIC, 4);
    }
    
    // Set initial active buffer
    buffer_mgr.active_buffer = 0;
    buffer_mgr.buffers[0].state = BUFFER_FILLING;
    
    return 0;
}

/* Get the currently active buffer */
struct ble_buffer *get_active_buffer(void) {
    return &buffer_mgr.buffers[buffer_mgr.active_buffer];
}

/* Switch between buffers */
void switch_buffers(void) {
    k_sem_take(&buffer_mgr.switch_lock, K_FOREVER);
    
    // Get current buffer
    struct ble_buffer *current = get_active_buffer();
    
    // If current buffer has data, mark it as ready
    if (current->hash_entries > 0) {
        k_sem_take(&current->lock, K_FOREVER);
        current->state = BUFFER_READY;
        current->header.sequence = buffer_mgr.msg_sequence++;
        current->header.timestamp = k_uptime_get_32();
        k_sem_give(&current->lock);
    }
    
    // Switch to other buffer
    buffer_mgr.active_buffer = (buffer_mgr.active_buffer + 1) % 2;
    struct ble_buffer *next = get_active_buffer();
    
    // Reset next buffer if it's not being sent
    if (next->state != BUFFER_SENDING) {
        reset_buffer(next);
    } else {
        LOG_WRN("Buffer switch delayed - other buffer still sending");
    }
    
    k_sem_give(&buffer_mgr.switch_lock);
}

/* Reset a buffer to initial state */
void reset_buffer(struct ble_buffer *buffer) {
    k_sem_take(&buffer->lock, K_FOREVER);
    
    // Clear header
    memset(&buffer->header, 0, sizeof(struct buffer_header));
    memset(buffer->header.magic, UART_HEADER_MAGIC, 4);
    
    // Clear hash table
    memset(buffer->hash_table, 0, sizeof(buffer->hash_table));
    
    // Reset counters and state
    buffer->hash_entries = 0;
    buffer->state = BUFFER_FILLING;
    
    k_sem_give(&buffer->lock);
}

/* Find or add a device to the buffer's hash table */
struct device_data *find_or_add_device(const bt_addr_le_t *addr, 
                                     struct ble_buffer *buffer) {
    uint32_t index = hash_mac(addr->a.val);
    uint32_t original_index = index;
    
    do {
        struct hash_entry *entry = &buffer->hash_table[index];
        
        // Check if device already exists
        if (entry->state == ENTRY_OCCUPIED &&
            memcmp(entry->device.addr, addr->a.val, 6) == 0) {
            return &entry->device;
        }
        
        // Look for empty or deleted slot
        if (entry->state != ENTRY_OCCUPIED) {
            // Check limits
            if (buffer->hash_entries >= MAX_DEVICES) {
                LOG_WRN("Maximum devices reached");
                return NULL;
            }
            
            // Add new device
            entry->state = ENTRY_OCCUPIED;
            memcpy(entry->device.addr, addr->a.val, 6);
            entry->device.n_adv = 0;
            entry->device.last_seen = k_uptime_get_32();
            buffer->hash_entries++;
            buffer->header.n_mac++;
            
            return &entry->device;
        }
        
        // Try next slot
        index = (index + 1) & HASH_MASK;
    } while (index != original_index);
    
    LOG_WRN("Hash table full");
    return NULL;
}
```

## src/buffer_manager.h
```c
#ifndef BUFFER_MANAGER_H
#define BUFFER_MANAGER_H

#include "ble_scanner.h"

/* Hash Table Configuration */
#define HASH_SIZE       64    /* Power of 2, > 4/3 * MAX_DEVICES */
#define HASH_MASK       (HASH_SIZE - 1)

/* Buffer States */
enum buffer_state {
    BUFFER_EMPTY,      /* Buffer is empty/unused */
    BUFFER_FILLING,    /* Currently collecting data */
    BUFFER_READY,      /* Ready for transmission */
    BUFFER_SENDING     /* Being transmitted */
};

/* Hash Table Entry States */
enum entry_state {
    ENTRY_EMPTY,       /* Slot never used */
    ENTRY_OCCUPIED,    /* Contains valid data */
    ENTRY_DELETED      /* Previously used, now deleted */
};

/* Hash Table Entry Structure */
struct hash_entry {
    enum entry_state state;
    struct device_data device;
};

/* Buffer Structure */
struct ble_buffer {
    struct buffer_header header;
    struct hash_entry hash_table[HASH_SIZE];
    uint16_t hash_entries;
    enum buffer_state state;
    struct k_sem lock;        /* Buffer access semaphore */
};

/* Double Buffer Manager */
struct buffer_manager {
    struct ble_buffer buffers[2];  /* Double buffer */
    uint8_t active_buffer;         /* Current active buffer index */
    struct k_sem switch_lock;      /* Buffer switching semaphore */
    uint8_t msg_sequence;          /* Global message sequence counter */
};

/* Function Declarations */
int buffer_manager_init(void);
struct ble_buffer *get_active_buffer(void);
void switch_buffers(void);
struct device_data *find_or_add_device(const bt_addr_le_t *addr, struct ble_buffer *buffer);
void reset_buffer(struct ble_buffer *buffer);
struct buffer_manager *get_buffer_manager(void);

#endif /* BUFFER_MANAGER_H */
```

## src/chunk_protocol.c
```c
#include "chunk_protocol.h"
#include "uart_handler.h"

LOG_MODULE_DECLARE(ble_scanner);

/* Calculate CRC16 for data verification */
uint16_t calculate_crc16(const uint8_t *data, size_t length) {
    uint16_t crc = 0xFFFF;
    
    for (size_t i = 0; i < length; i++) {
        crc ^= data[i];
        for (int j = 0; j < 8; j++) {
            if (crc & 1) {
                crc = (crc >> 1) ^ 0xA001;
            } else {
                crc = crc >> 1;
            }
        }
    }
    
    return crc;
}

/* Send a single chunk with retries */
static bool send_chunk(const struct chunk *chunk) {
    for (int retry = 0; retry < MAX_RETRIES; retry++) {
        // Send header
        uart_write_bytes((uint8_t*)&chunk->header, 
                        sizeof(struct chunk_header));
        
        // Send device data
        size_t data_size = chunk->header.n_devices * sizeof(struct device_data);
        uart_write_bytes((uint8_t*)chunk->devices, data_size);
        
        // Send CRC
        uart_write_bytes((uint8_t*)&chunk->crc, sizeof(uint16_t));
        
        // Wait for acknowledgment
        if (uart_wait_ack(chunk->header.sequence)) {
            return true;
        }
        
        LOG_WRN("Retry %d for chunk %d", retry + 1, chunk->header.sequence);
        k_sleep(K_MSEC(10));
    }
    
    return false;
}

/* Send complete buffer in chunks */
void send_buffer_chunked(struct ble_buffer *buffer) {
    k_sem_take(&buffer->lock, K_FOREVER);
    
    if (buffer->hash_entries == 0) {
        k_sem_give(&buffer->lock);
        return;
    }
    
    uint16_t devices_sent = 0;
    uint8_t chunk_sequence = 0;
    uint16_t hash_index = 0;
    
    struct chunk current_chunk;
    memset(&current_chunk, 0, sizeof(struct chunk));
    
    // Process all devices in hash table
    while (devices_sent < buffer->hash_entries) {
        // Prepare chunk header
        current_chunk.header.start_marker = UART_HEADER_MAGIC;
        current_chunk.header.sequence = chunk_sequence++;
        current_chunk.header.total_devices = buffer->hash_entries;
        current_chunk.header.chunk_offset = devices_sent / MAX_DEVICES_PER_CHUNK;
        
        // Set chunk type
        if (devices_sent == 0) {
            current_chunk.header.type = CHUNK_TYPE_START;
        } else if (devices_sent + MAX_DEVICES_PER_CHUNK >= buffer->hash_entries) {
            current_chunk.header.type = CHUNK_TYPE_END;
        } else {
            current_chunk.header.type = CHUNK_TYPE_DATA;
        }
        
        // Fill chunk with devices
        uint8_t devices_in_chunk = 0;
        while (devices_in_chunk < MAX_DEVICES_PER_CHUNK && 
               devices_sent < buffer->hash_entries) {
            // Find next occupied entry
            while (hash_index < HASH_SIZE && 
                   buffer->hash_table[hash_index].state != ENTRY_OCCUPIED) {
                hash_index++;
            }
            
            if (hash_index < HASH_SIZE) {
                // Copy device data
                memcpy(&current_chunk.devices[devices_in_chunk],
                       &buffer->hash_table[hash_index].device,
                       sizeof(struct device_data));
                devices_in_chunk++;
                devices_sent++;
                hash_index++;
            }
        }
        
        current_chunk.header.n_devices = devices_in_chunk;
        
        // Calculate CRC
        current_chunk.crc = calculate_crc16((uint8_t*)&current_chunk,
                                          sizeof(struct chunk_header) + 
                                          (devices_in_chunk * sizeof(struct device_data)));
        
        // Send chunk
        if (!send_chunk(&current_chunk)) {
            LOG_ERR("Failed to send chunk %d", current_chunk.header.sequence);
            k_sem_give(&buffer->lock);
            return;
        }
    }
    
    k_sem_give(&buffer->lock);
}
```

## src/chunk_protocol.h
```c
#ifndef CHUNK_PROTOCOL_H
#define CHUNK_PROTOCOL_H

#include "buffer_manager.h"

/* Chunk Configuration */
#define CHUNK_SIZE              128   /* Maximum chunk size */
#define MAX_RETRIES            3     /* Maximum transmission retries */
#define ACK_TIMEOUT_MS         100   /* Acknowledgment timeout */

/* Calculate maximum devices per chunk */
#define CHUNK_HEADER_SIZE      8
#define CHUNK_CRC_SIZE        2
#define CHUNK_PAYLOAD_SIZE    (CHUNK_SIZE - CHUNK_HEADER_SIZE - CHUNK_CRC_SIZE)
#define MAX_DEVICES_PER_CHUNK (CHUNK_PAYLOAD_SIZE / sizeof(struct device_data))

/* Chunk Types */
enum chunk_type {
    CHUNK_TYPE_START = 0x01,
    CHUNK_TYPE_DATA  = 0x02,
    CHUNK_TYPE_END   = 0x03,
    CHUNK_TYPE_ACK   = 0x04,
    CHUNK_TYPE_NACK  = 0x05
};

/* Chunk Header Structure */
struct __packed chunk_header {
    uint8_t start_marker;      /* Always 0x55 */
    uint8_t type;             /* Chunk type */
    uint8_t sequence;         /* Sequence number */
    uint8_t n_devices;        /* Number of devices in chunk */
    uint16_t total_devices;   /* Total devices in message */
    uint16_t chunk_offset;    /* Chunk number */
};

/* Complete Chunk Structure */
struct __packed chunk {
    struct chunk_header header;
    struct device_data devices[MAX_DEVICES_PER_CHUNK];
    uint16_t crc;
};

/* Function Declarations */
void send_buffer_chunked(struct ble_buffer *buffer);
uint16_t calculate_crc16(const uint8_t *data, size_t length);

#endif /* CHUNK_PROTOCOL_H */
```

## src/uart_handler.c
```c
#include "uart_handler.h"
#include <zephyr/logging/log.h>
#include "chunk_protocol.h"

LOG_MODULE_REGISTER(uart, LOG_LEVEL_DBG);

static const struct device *uart_dev;
static struct k_sem uart_sem;

/* UART write function */
int uart_write_bytes(const uint8_t *data, size_t len) {
    if (!uart_dev) {
        LOG_ERR("UART device not initialized");
        return -ENODEV;
    }

    LOG_DBG("Writing %d bytes to UART", len);
    for (size_t i = 0; i < len; i++) {
        uart_poll_out(uart_dev, data[i]);  // No return value to check
    }

    return 0;
}

/* UART read function with timeout */
int uart_read_byte(uint8_t *byte, k_timeout_t timeout) {
    if (!uart_dev) {
        LOG_ERR("UART device not initialized");
        return -ENODEV;
    }

    int ret;
    k_timepoint_t end_time = sys_timepoint_calc(timeout);

    do {
        ret = uart_poll_in(uart_dev, byte);
        if (ret == 0) {
            LOG_DBG("Read byte: 0x%02x", *byte);
            return 0;
        }
        if (ret != -EAGAIN) {
            LOG_ERR("UART read error: %d", ret);
            return ret;
        }
        k_sleep(K_MSEC(1));
    } while (sys_timepoint_expired(end_time) == false);

    LOG_DBG("Read timeout");
    return -ETIMEDOUT;
}

/* Initialize UART */
int uart_init(void) {
    int ret;

    // Get UART device
    uart_dev = DEVICE_DT_GET(DT_NODELABEL(uart0));
    if (!device_is_ready(uart_dev)) {
        LOG_ERR("UART device not ready");
        return -ENODEV;
    }

    LOG_INF("UART device %s is ready", uart_dev->name);

    // Initialize semaphore
    k_sem_init(&uart_sem, 1, 1);

    // Configure UART
    const struct uart_config config = {
        .baudrate = UART_BAUD_RATE,
        .parity = UART_CFG_PARITY_NONE,
        .stop_bits = UART_CFG_STOP_BITS_1,
        .data_bits = UART_CFG_DATA_BITS_8,
        .flow_ctrl = UART_CFG_FLOW_CTRL_NONE
    };

    ret = uart_configure(uart_dev, &config);
    if (ret) {
        LOG_ERR("Could not configure UART: %d", ret);
        return ret;
    }

    // Verify configuration
    struct uart_config check_config;
    ret = uart_config_get(uart_dev, &check_config);
    if (ret) {
        LOG_ERR("Could not get UART config: %d", ret);
        return ret;
    }

    if (check_config.baudrate != config.baudrate) {
        LOG_ERR("UART baudrate mismatch: set %d, got %d", 
                config.baudrate, check_config.baudrate);
        return -EINVAL;
    }

    LOG_INF("UART initialized successfully at %d baud", config.baudrate);
    
    // Send a test message
    const uint8_t test[] = "\r\nUART Test\r\n";
    ret = uart_write_bytes(test, sizeof(test) - 1);
    if (ret) {
        LOG_ERR("Failed to send test message: %d", ret);
        return ret;
    }

    return 0;
}

/* Wait for acknowledgment with timeout */
bool uart_wait_ack(uint8_t expected_sequence) {
    uint8_t rx_byte;
    int ret;

    LOG_DBG("Waiting for ACK with sequence %d", expected_sequence);

    // Wait for response
    ret = uart_read_byte(&rx_byte, K_MSEC(ACK_TIMEOUT_MS));
    if (ret == 0) {
        if (rx_byte == CHUNK_TYPE_ACK) {
            LOG_DBG("Received ACK");
            return true;
        } else if (rx_byte == CHUNK_TYPE_NACK) {
            LOG_WRN("Received NACK for sequence %d", expected_sequence);
        } else {
            LOG_WRN("Unexpected response: 0x%02x", rx_byte);
        }
    } else {
        LOG_WRN("Timeout waiting for ACK");
    }

    return false;
}
```

## src/uart_handler.h
```c
#ifndef UART_HANDLER_H
#define UART_HANDLER_H

#include <zephyr/kernel.h>
#include <zephyr/device.h>
#include <zephyr/drivers/uart.h>
#include <zephyr/logging/log.h>
#include "chunk_protocol.h"  /* For CHUNK_TYPE_* constants */

/* Constants */
#define UART_BAUD_RATE    115200
#define ACK_TIMEOUT_MS    100

/* Function declarations */
int uart_init(void);
int uart_write_bytes(const uint8_t *data, size_t len);
int uart_read_byte(uint8_t *byte, k_timeout_t timeout);
bool uart_wait_ack(uint8_t expected_sequence);

#endif /* UART_HANDLER_H */
```
